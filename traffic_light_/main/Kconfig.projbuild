## traffic_light_/main/Kconfig.projbuild
```kconfig
menu "Traffic Light Example Configuration"

config BUTTON_PIN
    int "Number of the PIN connected to the BUTTON"
	range 0 34
	default 26

config RED_LED_PIN
    int "Number of the RED LED PIN"
	range 0 34
	default 27

config YELLOW_LED_PIN
    int "Number of the YELLOW LED PIN"
	range 0 34
	default 14

config GREEN_LED_PIN
    int "Number of the GREEN LED PIN"
	range 0 34
	default 12

endmenu
```

## ws2812b/main/Kconfig.projbuild
```kconfig
menu "WIFI configuration"

	choice
		prompt "Wifi Mode"
		default WIFI_MODE_AP
		help
			Wifi Mode AP (access point to host own WIFI) or STA (station to connect to other WIFI)
		config WIFI_MODE_AP
			bool "Access point"
		config WIFI_MODE_STA
			bool "Station"			
	endchoice

	config AP_SSID
		string "Wifi AP SSID"
		default "esp32-ap"
		help
			SSID for the Access Point Wifi network (max 31 chars)

	config AP_PASSWORD
		string "Wifi AP password"
		help
			Password for the Wifi network (if needed)

	config AP_CHANNEL
		int "Wifi channel"
		default 0
		help
			Channel for the Wifi network

	choice
		prompt "Authentication mode"
		default WIFI_AUTH_WPA2_PSK
		help
			Authentication mode for the Wifi network
		config WIFI_AUTH_OPEN
			bool "Open"
		config WIFI_AUTH_WEP
			bool "WEP"
		config WIFI_AUTH_WPA_PSK
			bool "WPA-PSK"
		config WIFI_AUTH_WPA2_PSK
			bool "WPA2-PSK"
		config WIFI_AUTH_WPA_WPA2_PSK
			bool "WPA-PSK or WPA2-PSK"
		config WIFI_AUTH_WPA2_ENTERPRISE
			bool "WPA2 Enterprise"			
	endchoice

	config AP_HIDE_SSID
		bool "Hide SSID"
		default 0
		help
			Hide SSID

	config AP_MAX_CONNECTIONS
		int "Maximum concurrent connections"
		range 1 4
		default 4
		help
			Maximum number of concurrent connections (1-4)

	config AP_BEACON_INTERVAL	
		int "Beacon interval (ms)"
		range 100 60000
		default 100
		help
			Beacon interval in ms (100-60000)

	config STA_SSID
		string "Wifi STA SSID"
		help
			SSID of the Wifi network to connect to (max 31 chars)

	config STA_PASSWORD
		string "Wifi STA password"
		help
			Password for the Wifi network to connect to (if needed)

	config LED_STRIP_PIN
		int "Number of the PIN connected to the ws2812b led strip"
		range 0 34
		default 0
	
endmenu
```
